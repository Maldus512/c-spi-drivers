## Kconfig
```kconfig
menu "SPI library"
    menu "IO Expanders"
        config SPI_DEVICES_MCP23X17
            bool "MCP23x17 16-bit IO expander"
            help
                Enable the MCP23x17 SPI driver

        config SPI_DEVICES_MCP23S08
            bool "MCP23S08 16-bit IO expander"
            help
                Enable the MCP23S08 SPI driver
    endmenu

    menu "Analog to Digital Converters (ADCs)"
        config SPI_DEVICES_MCP3202
            bool "Microchip MCP3202"
            help
                Enable the MCP3202 SPI driver

        config SPI_DEVICES_MCP3204
            bool "Microchip MCP3204"
            help
                Enable the MCP3204 SPI driver
    endmenu

    menu "Digital to Analog Converters (DACs)"
        config SPI_DEVICES_DAC102S085
            bool "Texas Instruments DAC102S085"
            help
                Enable the DAC102S085 SPI driver
    endmenu

    menu "Resistance Temperature Detector to Digital Converters (RTDDs)"
        config SPI_DEVICES_MAX31865
            bool "Maxim MAX31865"
            help
                Enable the MAX31865 SPI driver
    endmenu

    menu "Ports"
        config SPI_ESP_IDF_PORT
            bool "ESP-IDF spi driver"
    endmenu

endmenu
```
